## ranch_os/Config.in
```kconfig
source "$BR2_EXTERNAL_RANCH_OS_PATH/package/gate-client/Config.in"
source "$BR2_EXTERNAL_RANCH_OS_PATH/package/base-station/Config.in"
```

## ranch_os/package/base-station/Config.in
```kconfig
config BR2_PACKAGE_BASE_STATION
	bool "Base Station Software"
	depends on BR2_PACKAGE_PYTHON3
	depends on BR2_PACKAGE_HOST_RUSTC_TARGET_ARCH_SUPPORTS
	select BR2_PACKAGE_PYTHON_SERIAL
	select BR2_PACKAGE_PYTHON_CRYPTOGRAPHY
	select BR2_PACKAGE_PYTHON_REQUESTS
	select BR2_PACKAGE_PYTHON3_SQLITE
	# --- New Additions for Provisioning ---
	select BR2_PACKAGE_NETWORK_MANAGER
	select BR2_PACKAGE_NETWORK_MANAGER_WIFI
	select BR2_PACKAGE_NETWORK_MANAGER_CLI
	select BR2_PACKAGE_DNSMASQ
	select BR2_PACKAGE_PYTHON_FLASK
	select BR2_PACKAGE_SUDO
	select BR2_PACKAGE_BRCMFMAC_SDIO_FIRMWARE_RPI
	select BR2_PACKAGE_BRCMFMAC_SDIO_FIRMWARE_RPI_WIFI
	select BR2_PACKAGE_BRCMFMAC_SDIO_FIRMWARE_RPI_BT
	select BR2_PACKAGE_UTIL_LINUX
	select BR2_PACKAGE_UTIL_LINUX_RFKILL
	select BR2_PACKAGE_WPA_SUPPLICANT
	select BR2_PACKAGE_WPA_SUPPLICANT_AP_SUPPORT
	select BR2_PACKAGE_WPA_SUPPLICANT_DBUS
	select BR2_PACKAGE_WPA_SUPPLICANT_NL80211
	select BR2_PACKAGE_WIRELESS_REGDB
	select BR2_PACKAGE_IW
	help
	  Installs the LoRa Base Station, Telegram integration, local DB, and SoftAP provisioning.
```

## ranch_os/package/gate-client/Config.in
```kconfig
config BR2_PACKAGE_GATE_CLIENT
	bool "Gate Client Software"
	depends on BR2_PACKAGE_PYTHON3
	depends on BR2_PACKAGE_HOST_RUSTC_TARGET_ARCH_SUPPORTS
	select BR2_PACKAGE_PYTHON_SERIAL
	select BR2_PACKAGE_PYTHON_CRYPTOGRAPHY
	# gpiozero drives the magnetic-sensor Button and relay OutputDevice in
	# gate_client.py; python-rpi-gpio is its pin-factory backend on Pi Zero W
	# (BCM2835). Without rpi-gpio, gpiozero falls through to other backends
	# none of which we ship, and the service crashes on first GPIO access.
	select BR2_PACKAGE_PYTHON_GPIOZERO
	select BR2_PACKAGE_PYTHON_RPI_GPIO
	help
	  Installs the Ranch Gate Monitor LoRa client and systemd service.
```
